## conf/bblayers.conf
```bitbake
# POKY_BBLAYERS_CONF_VERSION is increased each time build/conf/bblayers.conf
# changes incompatibly
POKY_BBLAYERS_CONF_VERSION = "2"

BBPATH = "${TOPDIR}"
BBFILES ?= ""

BBLAYERS ?= " \
  /home/tom/yocto/dunfell/poky/meta \
  /home/tom/yocto/dunfell/poky/meta-poky \
  /home/tom/yocto/dunfell/poky/meta-yocto-bsp \
  /home/tom/yocto/dunfell/build/live/meta-live-thomux \
  /home/tom/yocto/dunfell/build/live/meta-zinc \
  /home/tom/yocto/dunfell/build/live/workspace \
  "
```
